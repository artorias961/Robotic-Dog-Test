## CMakeLists.txt
```
# Test-001 Teensy1 - pings Teensy2 over Ethernet (Teensy 4.1, Zephyr RTOS, C++20)
cmake_minimum_required(VERSION 3.20.0)

find_package(Zephyr REQUIRED HINTS $ENV{ZEPHYR_BASE})
project(test001_teensy1)

target_sources(app PRIVATE src/main.cpp)
# common/comms.hpp: the IPs, port and packet both boards share
target_include_directories(app PRIVATE ../common)
```

## prj.conf
```kconfig
# Test-001 Teensy1 - Ethernet UDP test (Teensy 4.1, Zephyr v4.4)
# Same as Teensy2/prj.conf except for the IP address.

# ---- C++20 --------------------------------------------------------------------
CONFIG_CPP=y
CONFIG_STD_CPP20=y
# Full C++ standard library: std::optional, std::span, ...
CONFIG_REQUIRES_FULL_LIBCPP=y

# ---- Console over the Teensy's USB cable (shows up as a COM port) --------------
# Log output goes here. app.overlay points the console at this USB serial port.
CONFIG_USB_DEVICE_STACK_NEXT=y
CONFIG_CDC_ACM_SERIAL_INITIALIZE_AT_BOOT=y
CONFIG_SERIAL=y
CONFIG_CONSOLE=y
CONFIG_UART_CONSOLE=y
CONFIG_UART_LINE_CTRL=y
# This USB port carries the log, so its own driver can't log (it would loop).
CONFIG_USBD_CDC_ACM_LOG_LEVEL_OFF=y

# ---- LED on pin 13: toggles on every pong --------------------------------------
CONFIG_GPIO=y

# ---- Networking: static IPv4, no DHCP ------------------------------------------
# Ethernet itself needs nothing here: Zephyr's teensy41 board turns on the
# i.MX RT1062 Ethernet controller and the DP83825 chip on its own.
CONFIG_NETWORKING=y
CONFIG_NET_IPV4=y
CONFIG_NET_IPV6=n
CONFIG_NET_UDP=y
CONFIG_NET_SOCKETS=y
CONFIG_NET_CONFIG_SETTINGS=y
CONFIG_NET_CONFIG_NEED_IPV4=y
# Must match kTeensy1Ip in ../common/comms.hpp (the build fails otherwise).
CONFIG_NET_CONFIG_MY_IPV4_ADDR="192.168.1.101"
CONFIG_NET_CONFIG_MY_IPV4_NETMASK="255.255.255.0"
CONFIG_NET_DHCPV4=n
# Don't hold up boot waiting for the cable; main.cpp logs when the link is up.
CONFIG_NET_CONFIG_INIT_TIMEOUT=0

# ---- Logging and stacks ---------------------------------------------------------
CONFIG_LOG=y
CONFIG_MAIN_STACK_SIZE=4096
```

## app.overlay
```dts
/*
 * Test-001 Teensy1 devicetree overlay (Teensy 4.1)
 *
 * Sends the Zephyr console (log output) to a USB serial port on the Teensy's
 * micro-USB connector instead of the board's default console UART. Same as
 * Zephyr's cdc-acm-console snippet, and the same as the legs firmware.
 *
 * Ethernet needs nothing here: Zephyr's teensy41 board already turns it on.
 */

/ {
	chosen {
		zephyr,console = &cdc_acm_uart0;
		zephyr,shell-uart = &cdc_acm_uart0;
	};
};

&zephyr_udc0 {
	cdc_acm_uart0: cdc_acm_uart0 {
		compatible = "zephyr,cdc-acm-uart";
	};
};
```

## src/main.cpp
```c
// Test-001 Teensy1: every kPeriodMs, sends a numbered "ping" to Teensy2 over
// Ethernet (UDP, through the switch), waits for Teensy2's "pong", and logs
// the round-trip time. Every kSummaryEvery pings it logs how many came back.
// The LED on pin 13 toggles on every pong.
#include <zephyr/drivers/gpio.h>
#include <zephyr/kernel.h>
#include <zephyr/logging/log.h>
#include <zephyr/net/socket.h>
#include <zephyr/sys/printk.h>

#include <cerrno>
#include <cstdint>
#include <optional>

#include "comms.hpp"

LOG_MODULE_REGISTER(teensy1, LOG_LEVEL_INF);

namespace {

constexpr std::uint8_t kMe = 1;
constexpr int kPeriodMs = 500;        // one ping every half second
constexpr int kReplyTimeoutMs = 100;  // a pong later than this counts as lost
constexpr std::uint32_t kSummaryEvery = 10;

static_assert(comms::same(CONFIG_NET_CONFIG_MY_IPV4_ADDR, comms::kTeensy1Ip),
              "Teensy1/prj.conf's CONFIG_NET_CONFIG_MY_IPV4_ADDR must equal "
              "kTeensy1Ip in common/comms.hpp");

const gpio_dt_spec led = GPIO_DT_SPEC_GET(DT_ALIAS(led0), gpios);

struct Pong {
  comms::Packet packet;
  std::uint32_t rtt_us;  // ping sent -> pong received
};

// Waits up to kReplyTimeoutMs for the pong to ping number `seq`. Stray
// packets and late pongs to older pings are skipped.
std::optional<Pong> wait_for_pong(int sock, std::uint32_t seq) {
  const std::int64_t deadline = k_uptime_get() + kReplyTimeoutMs;
  for (;;) {
    const std::int64_t left = deadline - k_uptime_get();
    if (left <= 0 || !comms::readable(sock, static_cast<int>(left))) return std::nullopt;

    std::uint8_t buf[sizeof(comms::Packet) + 1];  // +1 so oversized packets fail parse()
    const auto n = zsock_recv(sock, buf, sizeof(buf), 0);
    const std::uint32_t now = k_cycle_get_32();
    if (n <= 0) continue;

    const auto p = comms::parse({buf, static_cast<std::size_t>(n)}, comms::Kind::Pong);
    if (!p || p->seq != seq) continue;
    // Unsigned subtraction stays correct when the 32-bit counter wraps.
    return Pong{*p, k_cyc_to_us_floor32(now - p->sent_cycles)};
  }
}

// Logs when the Ethernet link changes. Returns whether it is up now.
bool check_link(bool& was_up) {
  const bool up = comms::link_up();
  if (up && !was_up) LOG_INF("Ethernet link up");
  if (!up && was_up) LOG_WRN("Ethernet link down: check the cable and the switch");
  was_up = up;
  return up;
}

}  // namespace

int main() {
  gpio_pin_configure_dt(&led, GPIO_OUTPUT_INACTIVE);

  char mac[18];
  comms::mac_string(mac);
  LOG_INF("Test-001 Teensy1 (ip %s, mac %s): pings Teensy2 at %s:%u every %d ms",
          comms::kTeensy1Ip, mac, comms::kTeensy2Ip, comms::kPort, kPeriodMs);

  const int sock = comms::open_socket();
  if (sock < 0) {
    LOG_ERR("could not open UDP port %u (errno %d)", comms::kPort, errno);
    return 0;
  }
  const net_sockaddr_in teensy2 = comms::endpoint(comms::kTeensy2Ip);

  bool link_was_up = false;
  if (!comms::link_up()) LOG_INF("waiting for the Ethernet link ...");

  std::uint32_t sent = 0;
  std::uint32_t pongs = 0;
  for (;;) {
    const std::int64_t start = k_uptime_get();

    if (check_link(link_was_up)) {
      comms::Packet ping{};
      ping.magic = comms::kMagic;
      ping.seq = ++sent;
      ping.kind = comms::Kind::Ping;
      ping.from = kMe;
      snprintk(ping.text, sizeof(ping.text), "ping #%u from Teensy1", ping.seq);
      ping.sent_cycles = k_cycle_get_32();  // last, right before sending

      if (zsock_sendto(sock, &ping, sizeof(ping), 0,
                       reinterpret_cast<const net_sockaddr*>(&teensy2), sizeof(teensy2)) < 0) {
        LOG_WRN("#%u send failed (errno %d)", ping.seq, errno);
      } else if (const auto pong = wait_for_pong(sock, ping.seq)) {
        ++pongs;
        gpio_pin_toggle_dt(&led);
        LOG_INF("#%u pong in %u us: \"%s\"", ping.seq, pong->rtt_us, pong->packet.text);
      } else {
        LOG_WRN("#%u no pong within %d ms", ping.seq, kReplyTimeoutMs);
      }

      if (sent % kSummaryEvery == 0)
        LOG_INF("summary: %u pings sent, %u pongs back, %u lost", sent, pongs, sent - pongs);
    }

    // Keep a steady period no matter how long the pong took.
    const std::int64_t elapsed = k_uptime_get() - start;
    if (elapsed < kPeriodMs) k_msleep(static_cast<std::int32_t>(kPeriodMs - elapsed));
  }
}
```
